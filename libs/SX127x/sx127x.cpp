//
// Created by Dzmitryj Bareika on 8.01.25.
//

#include "sx127x.h"

const uint32_t SX127X::SX127X::bw[10] = {
    7800,  10400,  15600,
    20800, 31250,  41700,
    62500, 125000, 250000,
    500000
};

void SX127X::SX127X::writeRegister(uint8_t addr, uint8_t val)
{
  _spibuf[0] = addr | 0x80;
  _spibuf[1] = val;
  selectReceiver();
  spi_write_blocking(_spi_channel, _spibuf, 2);
  deselectReceiver();
  //  printf("%d", getOpMode());
}
uint8_t SX127X::SX127X::readRegister(uint8_t addr) {
  _spibuf[0] = addr & 0x7f;
  _spibuf[1] = 0x00;
  uint8_t value = 0;
  selectReceiver();
  spi_write_blocking(_spi_channel, &_spibuf[0], 1);
  spi_read_blocking(_spi_channel, _spibuf[1], &value, 1);
  deselectReceiver();
  return value;
}
void SX127X::SX127X::selectReceiver() const {
  gpio_put(this->_ss_pin, false);
}
void SX127X::SX127X::deselectReceiver() const {
  gpio_put(this->_ss_pin, true);
}


SX127X::SX127X::SX127X(spi_inst_t* spi, uint8_t miso, uint8_t mosi, uint8_t  clk, uint8_t cs, uint8_t rst, uint8_t dio0)  : _spi_channel(spi),
                                                                                                                          _miso(miso),
                                                                                                                          _mosi(mosi),
                                                                                                                          _clk(clk),
                                                                                                                          _ss_pin(cs),
                                                                                                                          _dio0_pin(dio0),
                                                                                                                          _rst_pin(rst){
  gpio_init(_ss_pin);
  gpio_init(_dio0_pin);
  gpio_init(_rst_pin);

  gpio_set_dir(_ss_pin, GPIO_OUT);
  gpio_set_dir(_dio0_pin, GPIO_IN);
  gpio_set_dir(_rst_pin, GPIO_OUT);

}

SX127X::SX127X *SX127X::SX127X::setFrequency(uint32_t frequency){
  uint64_t frf = (uint64_t(frequency) << 19) / 32000000;
  writeRegister(REG_FRF_MSB, (frf >> 16) & 0xFF);
  writeRegister(REG_FRF_MID, (frf >> 8) & 0xFF);
  writeRegister(REG_FRF_LSB, frf & 0xFF);

  return this;
}

SX127X::SX127X *SX127X::SX127X::setTXPower(uint8_t power){
  if (power > 17) power = 17;
  writeRegister(REG_PA_CONFIG, 0x80 | power);
  return this;
}

bool SX127X::SX127X::begin() {
  spi_init(_spi_channel, 5000000);

  gpio_set_function(_miso, GPIO_FUNC_SPI);
  gpio_set_function(_mosi, GPIO_FUNC_SPI);
  gpio_set_function(_clk, GPIO_FUNC_SPI);

//  gpio_put(_ss_pin, true);
//  gpio_put(_rst_pin, true);

  sleep();
  if (version() != 0x12)
  {
    return false;
  }
//  writeRegister(REG_FIFO_TX_BASE_ADDR, 0);
//  writeRegister(REG_FIFO_RX_BASE_ADDR, 0);

  return true;
}


SX127X::SX127X *SX127X::SX127X::setPreambleLength(uint16_t length) {
  writeRegister(REG_PREAMBLE_MSB, (length >> 8) & 0xFF);
  writeRegister(REG_PREAMBLE_LSB, length & 0xFF);

  return this;
}

SX127X::SX127X *SX127X::SX127X::setPayloadLength(uint8_t length) {
  writeRegister(REG_PAYLOAD_LENGTH, length);

  return this;
}

SX127X::SX127X *SX127X::SX127X::setModulationFSK(float dataRate, float deviation) {
  sleep();
  setOpMode(OPMODE_FSK);
  writeRegister(REG_OPMODE, 0x00); // FSK mode

  uint16_t bitrate = (uint16_t)((double)OSC_FREQ / (double)dataRate);
  writeRegister(REG_BITRATE_MSB, (bitrate >> 8) & 0xFF);
  writeRegister(REG_BITRATE_LSB, bitrate & 0xFF);

  // Настройка девиации
  uint16_t fdev = (deviation * 1000) / 61.03515625;
  writeRegister(REG_FDEV_MSB, (fdev >> 8) & 0xFF);
  writeRegister(REG_FDEV_LSB, fdev & 0xFF);

  writeRegister(REG_FIFO_THRESH, TX_START_CONDITION_FIFO_EMPTY);

  return this;
}

void SX127X::SX127X::setOpMode(uint8_t mode) {
    writeRegister(REG_OPMODE,(mode & OPMODE_MASK) | OPMODE_FSK);
}

void SX127X::SX127X::standby() {
    setOpMode(OPMODE_STANDBY);
}

uint8_t SX127X::SX127X::version() {
  gpio_put(this->_rst_pin, false);
  busy_wait_ms(100);
  gpio_put(this->_rst_pin, true);
  busy_wait_ms(100);
  uint8_t version = readRegister(REG_VERSION);
  return version;
}

void SX127X::SX127X::sleep() {
  setOpMode(OPMODE_SLEEP);
}
bool SX127X::SX127X::send(const etl::vector<uint8_t, 256>& data) {
  standby();

  if(getFSKConfig() & PC_PACKET_FORMAT_FIXED){
    setPayloadLength(data.size());
  }else{
    writeRegister(REG_FIFO, data.size());
  }

  for (unsigned char i : data) {
    writeRegister(REG_FIFO, i);
  }

  setOpMode(OPMODE_TX);

  while((readRegister(REG_IRQ_FLAGS_2) & IRQ_TXDONE_MASK) == 0)
    busy_wait_us(1);

  standby();

  return true;
}

uint8_t SX127X::SX127X::getOpMode() {
  return readRegister(REG_OPMODE) & OPMODE_MASK;
}

SX127X::SX127X *SX127X::SX127X::setFSKConfig(uint8_t config) {

  writeRegister(REG_PACKET_CONFIG_1, config);

  return this;
}

uint8_t SX127X::SX127X::getFSKConfig() {
  uint8_t config = readRegister(REG_PACKET_CONFIG_1);
  return config;
}
SX127X::SX127X *SX127X::SX127X::disableSyncWord() {
  writeRegister(REG_SYNC_CONFIG, 0x80); //save only RX restart on PPL
  return this;
}
