
//
// Created by Dzmitryj Bareika on 5.01.25.
//
#include "pico/stdlib.h"
#include "sx127x.h"
#include <cmath>
//#include <cstring>
#include <etl/vector.h>
#include "ProcessorFactory.h"
#include "VirtualTimer.h"


#include "NRZIProcessor.h"
#include "LFSRProcessor.h"


SX127X::SX127X radio = SX127X::SX127X(spi1, 12, 15, 14, 13, 6, 7);
ProcessorFactory processorFactory = ProcessorFactory();
//VirtualTimerManager& manager = VirtualTimerManager::getInstance();

DataProcessor* LFSR = new LFSRProcessor();
DataProcessor* NRZI = new NRZIProcessor();;

#define LED_PIN 25

void blink() {
  static bool ledState = false;
  ledState = !ledState;
  gpio_put(LED_PIN, ledState);
}

constexpr size_t TELEMETRY_SIZE = 62;
std::array<uint16_t, TELEMETRY_SIZE> MatherBoardTelemtry;

#include <array>
#include <random>
#include <cstdint>


void generateTelemetryData() {
  std::random_device rd;
  std::mt19937 gen(rd());
  std::uniform_int_distribution<uint16_t> voltageDist(1000, 5000);  // мВ
  std::uniform_int_distribution<uint16_t> currentDist(100, 3000);      // мА
  std::uniform_int_distribution<uint16_t> genericDist(100, 65535);

  for (size_t i = 0; i < TELEMETRY_SIZE; i++) {
    if (i % 2 == 0) {
      MatherBoardTelemtry[i] = voltageDist(gen);
    } else {
      MatherBoardTelemtry[i] = currentDist(gen);
    }
  }
  MatherBoardTelemtry[14] = genericDist(gen);  // ResetCounter
  MatherBoardTelemtry[15] = genericDist(gen);  // Time part 1
  MatherBoardTelemtry[16] = genericDist(gen);  // Time part 2
  MatherBoardTelemtry[17] = 100;              // Fixed value
  MatherBoardTelemtry[18] = 120;              // CPU clock MHz
  MatherBoardTelemtry[19] = genericDist(gen); // CPU temperature
}

etl::vector<uint8_t, 256> convertToETLVector(const std::array<uint16_t, TELEMETRY_SIZE>& data) {
  etl::vector<uint8_t, 256> result;
  for (const auto& value : data) {
    result.push_back(static_cast<uint8_t>(value & 0xFF));
    result.push_back(static_cast<uint8_t>(value >> 8)); // Старший байт
     // Младший байт
  }
  return result;
}

etl::vector<uint8_t, 256> etlVector;

etl::vector<uint8_t, 256> Data = {
    0xFF, 0x00, 0xAA, 0x55, 0xF0, 0x0F, 0x1E, 0x3C,
    0xC3, 0x92, 0xA1, 0x50, 0x9F, 0xB4, 0xCD, 0x67,
    0x5A, 0x8B, 0xED, 0x72, 0x96, 0x43, 0x1D, 0xF1,
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    0xFF, 0x00, 0xAA, 0x55, 0xF0, 0x0F, 0x1E, 0x3C,


};

void onTimer1() {
  generateTelemetryData();
  etlVector = convertToETLVector(MatherBoardTelemtry);
  radio.send(processorFactory.CreateRadioPacket(etlVector));
}


#define DIO0_PIN 7
void sx1278_payload_ready_isr(uint gpio, uint32_t events) {
  printf("Payload Ready Interrupt!\n");
}

void setup_gpio_interrupt() {
  gpio_init(DIO0_PIN);
  gpio_set_dir(DIO0_PIN, GPIO_IN);
  gpio_pull_up(DIO0_PIN);
  gpio_set_irq_enabled_with_callback(DIO0_PIN, GPIO_IRQ_EDGE_RISE, true, &sx1278_payload_ready_isr);
}

int main() {

  if(radio.begin())
    radio.setModulationFSK(9600, 4.8)
        ->setTXPower(10)
        ->setFrequency(SX127X::SX127X::FREQ_433)
        ->setFSKConfig(PC_PACKET_FORMAT_FIXED | PC_DC_FREE_OFF | PC_CRC_ON | PC_CRC_AUTO_CLEAR_OFF)
        ->disableSyncWord()
        ->setPreambleLength(0);
//        ->setOpMode(OPMODE_RX | OPMODE_STANDBY);


  gpio_init(LED_PIN);
  gpio_set_dir(LED_PIN, GPIO_OUT);

  processorFactory.ChangeProcessorType(ProcessorFactory::RADIO);
  processorFactory.SetupAX25("BSAT-1", "BSUGS");

  setup_gpio_interrupt();

//  VirtualTimer timer1(500000, onTimer1, true);
//  VirtualTimer ledTimer(250000, blink, true);
//
//  manager.addTimer(&timer1);
//  manager.addTimer(&ledTimer);
//
//  generateTelemetryData();
//  etlVector = convertToETLVector(MatherBoardTelemtry);
//
//  ledTimer.start();
//  timer1.start();

  etl::vector<uint8_t, 256> data;

  while (true) {
    data.clear();
    radio.setPayloadLength(33);
    data = radio.recive();
    etl::vector<uint8_t, 256> DeNRZI = NRZI->ProcessDecode(data);
    etl::vector<uint8_t, 256> payload = LFSR->ProcessDecode(DeNRZI);
    busy_wait_ms(1);

//    tight_loop_contents();
  }
}
